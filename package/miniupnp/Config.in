## package/miniupnp/Config.in
```kconfig
config BR2_PACKAGE_MINIUPNP
	bool "miniupnp"
	help
	  The MiniUPnP project offers software which supports the UPnP Internet
	  Gateway Device (IGD) specifications. NAT-PMP and PCP support was added
	  to MiniUPnPd.

	  http://miniupnp.free.fr/

if BR2_PACKAGE_MINIUPNP

config BR2_TARGET_ENABLE_MINIUPNPD
	bool "miniupnpd"
	help
	  The MiniUPnP daemon (MiniUPnPd) supports OpenBSD, FreeBSD, NetBSD,
	  DragonFly BSD, (Open)Solaris and Mac OS X in combination with pf or ipfw
	  (ipfirewall) or ipf and Linux with netfilter.

config BR2_TARGET_ENABLE_MINIUPNPC
	bool "miniupnpc"
	help
	  The MiniUPnP client (MiniUPnPc) and MiniSSDPd are portable and should work
	  on any POSIX system. MiniUPnPc also works under MS Windows and AmigaOS
	  (version 3 and 4).

endif
```

## package/ntpclient/Config.in
```kconfig
config BR2_PACKAGE_NTPCLIENT
	bool "ntp client"
	help  
	  ntpclient is an NTP (Network Time Protocol) RFC-1305 client for
	  unix-alike computers. Its functionality is a small subset of xntpd,
	  but IMHO performs better (or at least has the potential to function
	  better) with that limited scope. Since it is much smaller than xntpd,
	  it is also more relevant for embedded computers.

	  http://doolittle.icarus.com/ntpclient/
```

## package/portmap/Config.in
```kconfig
config BR2_PACKAGE_PORTMAP
	bool "portmap"
	help
	  Like all portmappers, this one is intended to be started at boot time.
	  Daemons that offer RPC services tell the portmapper on what port they
	  listen. Unlike the well-known services registered with the inetd, RPC
	  network port numbers may change each time the system is booted.
	  Whenever a client wants to use an RPC service it is supposed to first
	  ask the portmapper on what port the corresponding daemon is listening.
	  The rpcinfo command can tell you what RPC services your system offers.
	  
	  As described in the features section below, the replacement portmapper
	  can prevent undesirable client-server interactions.  In some cases,
	  better or equivalent alternatives are available:
	  
	      The SunOS portmap that is provided with patch id 100482-02 should
	      close the same security holes.  In addition, it provides an YPSERV
	      daemon with its own access control list. This is better than just
	      portmapper access control.
	  
	      The "securelib" shared library (eecs.nwu.edu:/pub/securelib.tar)
	      implements access control for all kinds of (RPC) services, not
	      just the portmapper.
	  
	  However, vendors still ship portmap implementations that allow anyone
	  to read or modify its tables and that will happily forward any request
	  so that it appears to come from the local system.

	  git://git.neil.brown.name/portmap.git
```

## package/pppoecd/Config.in
```kconfig
config BR2_PACKAGE_PPPOECD
	bool "pppoecd"
	help
	  PPPoE is a technique for the encapsulation of PPP streams inside of
	  Ethernet frames. The technology is being deployed by high-speed Internet
	  access providers (cable modems, xDSL, etc.) in order to decouple the
	  supply of bandwidth from ISP services.

	  Further details on PPPoE can be found in RFC2516.
```

## package/pptp/Config.in
```kconfig
config BR2_PACKAGE_PPTP
    bool "pptp"
    help
      pptp is an implementation of the PPTP protocol for Linux and other
      UNIX systems.

      http://pptpclient.sourceforge.net/
```

## package/pptpd/Config.in
```kconfig
config BR2_PACKAGE_PPTPD
	bool "pptpd"
	help
	  PoPToP Point to Point Tunneling Server
```

## package/router/Config.in
```kconfig
config BR2_PACKAGE_ROUTER
	bool "Router"
	default y
	help
	  Vendor router modules to build up the router core.

if BR2_PACKAGE_ROUTER

config BR2_PACKAGE_ROUTER_CONFIG
	string "Router configuration file to use?"
	default "package/router/router.config"
	help
	  Some people may wish to use their own modified router
	  configuration file, and will specify their config file
	  location with this option.

	  Most people will just use the default configuration file.

config BR2_PACKAGE_ROUTER_AUTOCONF
	string "Router autoconf head file generated by kconfig"
	default "include/autoconf.h"
	help
	  kconfig will generate a header file responding to the
	  config file. It defines the file for customization
	  purpose.

config BR2_PACKAGE_ROUTER_VENDOR
	string "Router vendor"
	help
	  It indicates the vendor software base beyond the hardware
	  maker to activiate the flexible configuration.

config BR2_PACKAGE_ROUTER_PREBUILTS
	string "Router prebuilt tool"
	help
	  It indicates the specified prebuilt tools to construct
	  router images after a successful compilation.

endif
```

## package/rp-l2tp/Config.in
```kconfig
config BR2_PACKAGE_RP_L2TP
	bool "rp-l2tp"
	help
	  This is a user-space implementation of L2TP (RFC 2661) for Linux.
```

## package/src-base/Config.in
```kconfig
config BR2_PACKAGE_SRC_BASE
	bool "src-base"
	help
	  Vendor router src base directory excluding router directory.

	  It provides the extra files like Makefile, router components.

if BR2_PACKAGE_SRC_BASE

config BR2_PACKAGE_SRC_BASE_OVERRIDED_TARGET
	string "src-base overrided target file"
	help
	  Overrided target makefile for specified config beyond the original

endif
```

## package/tre/Config.in
```kconfig
config BR2_PACKAGE_TRE
	bool tre
	help
	  tre is a lightweight, robust, and efficent POSIX compliant regexp
	  matching library with some exciting features such as approximate
	  (fuzzy) matching.
```

## package/udev/Config.in
```kconfig
config BR2_PACKAGE_UDEV
	bool "udev"
	help
      udev will be responsible for responding to /sbin/hotplug on device
      events. It will receive the device class information along with
      device's sysfs directory.
      
      udev will consist of a command udev - to be called from /sbin/hotplug.
      it will require the in memory dynamic database/table for keeping track
      of current system devices, and a library of routines for accessing that
      will be separated into the device naming subsystem. It's presented a
      common device naming API by the device naming subsystem to use for naming
      devices.
```

## package/udhcpd/Config.in
```kconfig
config BR2_PACKAGE_UDHCPD
	bool "udhcpd"
	help
	  udhcp server/client package is primarily geared towards embedded
	  systems. It does however, strive to be fully functionaly, and RFC
	  compliant.
```

## package/vlan/Config.in
```kconfig
config BR2_PACKAGE_VLAN
	bool "Virtual LAN"
	help
	  A 802.11Q VLAN implementation for Linux.

	  https://www.candelatech.com/~greear/vlan.html
```

## package/wakelan/Config.in
```kconfig
config BR2_PACKAGE_WAKELAN
	bool "Wake on LAN (WOL)"
	help
	  Wake-on-LAN (WoL) is a standard that allows a user to send a packet over
	  the network to one or more computers that are off to turn those computers
	  on.

	  Some of home routers can send the packet from the router's configuration
	  page. Alternatively, WoL software utitilies can be used, or, online
	  websites exist that can send the package.
```

## package/wxwidgets/Config.in
```kconfig
config BR2_PACKAGE_WXWIDGETS
	bool "wxwidgets"
	help
	  wxWidgets is a C++ library that lets developers create applications
	  for Windows, Mac OS X, Linux and other platforms with a signle code
	  base. It has popular language bindings for Python, Perl, Ruby and many
	  other languages, and unlike other cross-platform toolkits, wxWidgets
	  gives applications a truly native look and feel because it uses the
	  platform's native API rather than enulating the GUI.

	  http://wxwidgets.org/
```

## package/xz/Config.in
```kconfig
config BR2_PACKAGE_XZ
	bool "xz-utils"
	help
	  XZ is the successor to the Lempel-Ziv/Markov-chain Algorithm
	  compression format, which provides memory-hungry but powerful
	  compression (often better than bzip2) and fast, easy decompression.

	  This package provides the command line tools for working with XZ
	  compression, including xz, unxz, xzcat, xzgrep, and so on. They can
	  also handle the older LZMA format, and if invoked via appropriate
	  symlinks will emulate the behavior of the commands in the lzma
	  package.

	  http://tukaani.org/xz/

if BR2_PACKAGE_XZ
config BR2_PACKAGE_XZ_XZ
	bool "xz"
	default y
	help
	  build xz tool
      
config BR2_PACKAGE_XZ_XZDEC
	bool "xzdec"
	default y
	help
	  build xzdec
      
config BR2_PACKAGE_XZ_LZXZDEC
	bool "lzmadec"
	default y
    help
      build lzmadec
      
config BR2_PACKAGE_XZ_LZMAINFO
	bool "lzmainfo"
	default y
	help
	  build lzmainfo
      
config BR2_PACKAGE_XZ_LZMALINK
	bool "lzmalink"
	default y
	help
	  create symlinks for LZMA utils compatibility
    
config BR2_PACKAGE_XZ_LZMA_SCRIPTS
	bool "lzma scripts"
	default y
	help
	  install the scripts xzdiff, xzgrep, xzless, xzmore and their links

endif
```

## package/zebra/Config.in
```kconfig
config BR2_PACKAGE_ZEBRA
	bool "zebra"
	help
	  zebra is a multi-server routing software which provides TCP/IP based
	  routing protocols. zebra turns your machine into a full powered router.

	  http://www.zebra.org/

if BR2_PACKAGE_ZEBRA

config BR2_PACKAGE_ZEBRA_NETLINK
  bool "Linux netlink interface"
  help
    Force to use Linux netlink interface

config BR2_PACKAGE_ZEBRA_TCP_ZEBRA
  bool "Use TCP sockets between zebra and protocol daemons"
  help
    Use a TCP socket to communicate between zebra (supervisor)
    and the different protocol daemons.

    You'll want this enabled if zebra and the protocol daemon(s)
    run on different hosts.

config BR2_PACKAGE_ZEBRA_IPV6
  bool "IPv6"
  help
    Turn on IPv6 related features and daemons.

config BR2_PACKAGE_ZEBRA_BGPD
  bool "BGPv4+ protocol"
  help
    Build bgpd daemon.

config BR2_PACKAGE_ZEBRA_BGP_ANNOUNCE
  bool "BGP route announcement"
  depends on BR2_PACKAGE_ZEBRA_BGPD

config BR2_PACKAGE_ZEBRA_OSPFD
  bool "OSPFv2 protocol"
  help
    Build ospfd daemon.

config BR2_PACKAGE_ZEBRA_OSPF6D
  bool "OSPFv3 (IPv6) protocol"
  help
    Build ospf6d daemon.

config BR2_PACKAGE_ZEBRA_RIPNGD
  bool "RIPng (IPv6) protocol"
  help
    Build ripngd daemon.

endif
```

## package/zeroconf/Config.in
```kconfig
config BR2_PACKAGE_ZEROCONF
	bool "zeroconf"
	help
	  zeroconf is an implementation of IPv4 link-local addresses (RFC3927)
	  which can be used for ad-hoc neworks. Addresses are allocated from the
	  169.254.0.0/16 range semi-randomly. That menas making it possible to
	  take two laptop computers, and connect them with a crossover Ethernet
	  cable, and have them communicate usefully using IP, without needing
	  any additional setup.

	  http://www.zeroconf.org
```
