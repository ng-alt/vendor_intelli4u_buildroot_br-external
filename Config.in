## package/l7protocols/Config.in
```kconfig
config BR2_PACKAGE_L7PROTOCOLS
	bool "l7protocols"
	help
	  There are patterns (protocol definitions) for the Linux layer 7
	  packet classifier (l7-filter).

	  http://sf.net/projects/l7-filter/

if BR2_PACKAGE_L7PROTOCOLS

config BR2_TARGET_L7PROTOCOLS_PATH
	string "l7protocols target path"
	default "etc/l7-protocols"

endif
```

## package/libantlr/Config.in
```kconfig
config BR2_PACKAGE_LIBANTLR
	bool "libantlr"
	help
	  ANTLR is the most powerful, easy-to-use parser generator
	  built to date, and represents the culmination of more than
	  15 years of research.
```

## package/libavl/Config.in
```kconfig
config BR2_PACKAGE_LIBAVL
	bool libavl
	help
	  AVLTree is a small implementation of AVL trees for the C programming
	  language. It is distributed under the library GPL.

	  The library does the basic stuff. It allows for inserts, searches, and
	  deletes in O(log n) time. It also allows the tree to be used as a linked
	  indexable list (search/insert functions cannot be used in that case).
```

## package/libcryptoxx/Config.in
```kconfig
config BR2_PACKAGE_LIBCRYPTOXX
	bool "Crypto++ Library"
	help
	  Crypto++ library is a free C++ class library of cryptographic schemes.
	  The library contains lots of algorithms.

	  https://www.cryptopp.com/
```

## package/libsmbclient/Config.in
```kconfig
config BR2_PACKAGE_LIBSMBCLIENT
	bool "samba"
	depends on BR2_TOOLCHAIN_HAS_THREADS
	depends on BR2_USE_MMU # fork()
	depends on !BR2_nios2 # binary too large, relocations don't fit
	select BR2_PACKAGE_POPT
	help
	  Base on samba source to build libsmbclient library

	  http://www.samba.org/

	  NOTE: A complete Samba install takes over 50MB of space,
		so choose only the components you need.
```

## package/libubox/Config.in
```kconfig
config BR2_PACKAGE_LIBUBOX
	bool "libubox"
	help
	  This library originates from the OpenWrt project to
	  handle the configuration file infrastructure, but can
	  also be used for the same purposes in projects other
	  than OpenWrt.

	  http://nbd.name/gitweb.cgi?p=luci2/libubox.git;a=summary
```
