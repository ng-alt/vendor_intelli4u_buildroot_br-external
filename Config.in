## configs/r6400_defconfig
```kconfig
#
# Build options
#

#
# Commands
#
BR2_DEFCONFIG="$(BR2_EXTERNAL_NETGEAR_PATH)/configs/r6400_defconfig"
BR2_ENVIRON_CONFIGS="$(BR2_EXTERNAL_NETGEAR_PATH)/board/common/build.config $(BR2_EXTERNAL_NETGEAR_PATH)/board/common/netgear.config"
BR2_GLOBAL_EXPORT_VAR="PROFILE=R6400 VENDOR=netgear"

#
# System configuration
#
# BR2_ROOTFS_SKELETON_DEFAULT is not set
BR2_ROOTFS_SKELETON_CUSTOM=y
BR2_ROOTFS_SKELETON_CUSTOM_PATH="$(BR2_EXTERNAL_NETGEAR_PATH)/skeleton/r6400"

#
# Kernel
#
BR2_LINUX_KERNEL_CUSTOM_CONFIG_FILE="$(BR2_EXTERNAL_NETGEAR_PATH)/board/r6400/kernel.config"

#
# External options
#

#
# Netgear router external tree
#
BR2_EXTERNAL_NETGEAR_PATH="$(BR2_EXTERNAL)"

#
# Target packages
#
BR2_PACKAGE_BUSYBOX=y
BR2_PACKAGE_BUSYBOX_CONFIG="$(BR2_EXTERNAL_NETGEAR_PATH)/board/common/busybox.config"
BR2_PACKAGE_BUSYBOX_CONFIG_FRAGMENT_FILES=""
BR2_PACKAGE_BUSYBOX_SHOW_OTHERS=y
# BR2_PACKAGE_BUSYBOX_INDIVIDUAL_BINARIES is not set
# BR2_PACKAGE_BUSYBOX_WATCHDOG is not set

#
# Audio/Sound
#
BR2_PACKAGE_ALSA_LIB=y
# BR2_PACKAGE_ALSA_LIB_PYTHON is not set
BR2_PACKAGE_ALSA_LIB_DEVDIR="/dev/snd"
BR2_PACKAGE_ALSA_LIB_PCM_PLUGINS="all"
BR2_PACKAGE_ALSA_LIB_CTL_PLUGINS="all"
BR2_PACKAGE_ALSA_LIB_ALOAD=y
BR2_PACKAGE_ALSA_LIB_MIXER=y
BR2_PACKAGE_ALSA_LIB_PCM=y
# BR2_PACKAGE_ALSA_LIB_RAWMIDI is not set
BR2_PACKAGE_ALSA_LIB_HWDEP=y
BR2_PACKAGE_ALSA_LIB_SEQ=y
# BR2_PACKAGE_ALSA_LIB_ALISP is not set
# BR2_PACKAGE_ALSA_LIB_OLD_SYMBOLS is not set
# BR2_PAKCAGE_ALSA_UCM is not set
BR2_PACKAGE_LIBID3TAG=y
BR2_PACKAGE_LIBVORBIS=y

#
# Audio and video applications
#
BR2_PACKAGE_FFMPEG_ARCH_SUPPORTS=y
BR2_PACKAGE_FFMPEG=y
# BR2_PACKAGE_FFMPEG_GPL is not set
# BR2_PACKAGE_FFMPEG_NONFREE is not set
BR2_PACKAGE_FFMPEG_FFMPEG=y
# BR2_PACKAGE_FFMPEG_FFPLAY is not set
# BR2_PACKAGE_FFMPEG_FFSERVER is not set
# BR2_PACKAGE_FFMPEG_FFPROBE is not set
# BR2_PACKAGE_FFMPEG_AVRESAMPLE is not set
BR2_PACKAGE_FFMPEG_SWSCALE=y
BR2_PACKAGE_FFMPEG_ENCODERS="all"
BR2_PACKAGE_FFMPEG_DECODERS="all"
BR2_PACKAGE_FFMPEG_MUXERS="all"
BR2_PACKAGE_FFMPEG_DEMUXERS="all"
BR2_PACKAGE_FFMPEG_PARSERS="all"
BR2_PACKAGE_FFMPEG_BSFS="all"
BR2_PACKAGE_FFMPEG_PROTOCOLS="all"
BR2_PACKAGE_FFMPEG_FILTERS="all"
BR2_PACKAGE_FFMPEG_INDEVS=y
BR2_PACKAGE_FFMPEG_OUTDEVS=y
BR2_PACKAGE_FFMPEG_EXTRACONF=""
BR2_PACKAGE_FLAC=y

#
# Compressors and decompressors
#
BR2_PACKAGE_BZIP2=y
BR2_PACKAGE_UNZIP=y
BR2_PACKAGE_XZ=y
# BR2_PACKAGE_XZ_XZ is not set
# BR2_PACKAGE_XZ_XZDEC is not set
# BR2_PACKAGE_XZ_LZXZDEC is not set
# BR2_PACKAGE_XZ_LZMAINFO is not set
# BR2_PACKAGE_XZ_LZMALINK is not set
# BR2_PACKAGE_XZ_LZMA_SCRIPTS is not set
BR2_PACKAGE_ZIP=y

#
# Development tools
#
BR2_PACKAGE_FLEX=y
BR2_PACKAGE_GETTEXT=y
BR2_PACKAGE_GPERF=y
BR2_PACKAGE_LIBAVL=y

#
# Filesystem and flash utilities
#
# BR2_PACKAGE_CRAMFS is not set
# BR2_PACKAGE_MTOOLS is not set
# BR2_PACKAGE_NTFS_3G is not set
BR2_PACKAGE_SQUASHFS=y
# BR2_PACKAGE_SQUASHFS_GZIP is not set
# BR2_PACKAGE_SQUASHFS_LZ4 is not set
BR2_PACKAGE_SQUASHFS_LZMA=y
# BR2_PACKAGE_SQUASHFS_LZO is not set
# BR2_PACKAGE_SQUASHFS_XZ is not set

#
# Compression and decompression
#
# BR2_PACKAGE_LZ4 is not set
BR2_PACKAGE_LZO=y
BR2_PACKAGE_ZLIB=y

#
# Crypto
#
BR2_PACKAGE_LIBCRYPTOXX=y
BR2_PACKAGE_LIBGCRYPT=y
BR2_PACKAGE_LIBGPG_ERROR_ARCH_SUPPORTS=y
BR2_PACKAGE_LIBGPG_ERROR=y
BR2_PACKAGE_LIBGPG_ERROR_SYSCFG="arm-unknown-linux-gnueabi"
BR2_PACKAGE_OPENSSL=y
BR2_PACKAGE_OPENSSL_BIN=y
# BR2_PACKAGE_OPENSSL_ENGINES is not set

#
# Database
#
BR2_PACKAGE_BERKELEYDB=y
# BR2_PACKAGE_BERKELEYDB_COMPAT185 is not set
# BR2_PACKAGE_BERKELEYDB_TOOLS is not set
BR2_PACKAGE_GDBM=y
BR2_PACKAGE_SQLITE=y
# BR2_PACKAGE_SQLITE_STAT3 is not set
# BR2_PACKAGE_SQLITE_ENABLE_FTS3 is not set
# BR2_PACKAGE_SQLITE_ENABLE_JSON1 is not set
BR2_PACKAGE_SQLITE_ENABLE_UNLOCK_NOTIFY=y
# BR2_PACKAGE_SQLITE_SECURE_DELETE is not set
# BR2_PACKAGE_SQLITE_NO_SYNC is not set

#
# Filesystem
#
BR2_PACKAGE_LIBCONFUSE=y

#
# Graphics
#
BR2_PACKAGE_JPEG=y
BR2_PACKAGE_LIBJPEG=y
# BR2_PACKAGE_JPEG_TURBO is not set
BR2_PACKAGE_HAS_JPEG=y
BR2_PACKAGE_PROVIDES_JPEG="libjpeg"
BR2_PACKAGE_LIBEXIF=y

#
# Hardware Handling
#
BR2_PACKAGE_DBUS=y
BR2_PACKAGE_HD_IDLE=y
BR2_PACKAGE_HDPARM=y
BR2_PACKAGE_HOTPLUG2=y
BR2_PACKAGE_UDEV=y

#
# Interpreter languages and scripting
#
BR2_PACKAGE_PYTHON=y
# BR2_PACKAGE_PYTHON_PY_ONLY is not set
BR2_PACKAGE_PYTHON_PYC_ONLY=y
# BR2_PACKAGE_PYTHON_PY_PYC is not set

#
# JSON/XML
#
BR2_PACKAGE_EXPAT=y
BR2_PACKAGE_LIBXML2=y
BR2_PACKAGE_MXML=y

#
# Multimedia
#
BR2_PACKAGE_LIBOGG=y

#
# Networking
#
BR2_PACKAGE_GEOIP=y
BR2_PACKAGE_LIBCURL=y
BR2_PACKAGE_CURL
# BR2_PACKAGE_LIBCURL_VERBOSE is not set
BR2_PACKAGE_LIBPCAP=y

#
# Other
#
BR2_PACKAGE_LIBANTLR=y
BR2_PACKAGE_LIBDAEMON=y
BR2_PACKAGE_LIBEVENT=y

#
# Text and terminal handling
#
BR2_PACKAGE_LIBICONV=y
BR2_PACKAGE_LIBUNISTRING=y
BR2_PACKAGE_TRE=y

#
# Networking applications
#
BR2_PACKAGE_AMULE=y
BR2_PACKAGE_AVAHI=y
BR2_PACKAGE_AVAHI_AUTOIPD=y
BR2_PACKAGE_AVAHI_DAEMON=y
# BR2_PACKAGE_AVAHI_LIBDNSSD_COMPATIBILITY is not set
BR2_PACKAGE_BFTPD=y
BR2_PACKAGE_BRIDGE_UTILS=y
BR2_PACKAGE_DHCP=y
BR2_PACKAGE_DNSMASQ=y
BR2_PACKAGE_DNSMASQ_TFTP=y
BR2_PACKAGE_DNSMASQ_DHCP=y
# BR2_PACKAGE_DNSMASQ_DNSSEC is not set
# BR2_PACKAGE_DNSMASQ_IDN is not set
# BR2_PACKAGE_DNSMASQ_LUA is not set
# BR2_PACKAGE_DNSMASQ_CONNTRACK is not set
BR2_PACKAGE_FORKED_DAAPD=y
BR2_PACKAGE_IGMPV3PROXY=y
BR2_PACKAGE_IPERF=y
BR2_PACKAGE_IPROUTE2=y
BR2_PACKAGE_IPTABLES=y
# BR2_PACKAGE_IPTABLES_BPF_NFSYNPROXY is not set
BR2_PACKAGE_IPTABLES_IPV4=y
BR2_PACKAGE_IPTABLES_IPV6=y
# BR2_PACKAGE_IPTABLES_EXTENSIONS is not set

#
# nftables compat needs a toolchain w/ wchar, dynamic library, headers >= 3.12
#
BR2_PACKAGE_L2TPD=y
BR2_PACKAGE_MINIDLNA=y
BR2_PACKAGE_NETATALK=y
# BR2_PACKAGE_NETATALK_A2BOOT is not set
# BR2_PACKAGE_NETATALK_ATFUNCS is not set
# BR2_PACKAGE_NETATALK_APPLETAK is not set
# BR2_PACKAGE_NETATALK_BINARIES is not set
# BR2_PACKAGE_NETATALK_TIMELORD is not set
BR2_PACKAGE_NTPCLIENT=y
BR2_PACKAGE_OPENVPN=y
# BR2_PACKAGE_OPENVPN_LZ4 is not set
BR2_PACKAGE_OPENVPN_LZO=y
# BR2_PACKAGE_OPENVPN_SMALL is not set
BR2_PACKAGE_PPPD=y
# BR2_PACKAGE_PPPD_FILTER is not set
# BR2_PACKAGE_PPPD_RADIUS is not set
BR2_PACKAGE_PPPOECD=y
BR2_PACKAGE_PPTP=y
BR2_PACKAGE_RADVD=y
BR2_PACKAGE_SAMBA4=y
# BR2_PACKAGE_SAMBA4_AD_DC is not set
# BR2_PACKAGE_SAMBA4_ADS is not set
# BR2_PACKAGE_SAMBA4_SMBTORTURE is not set
BR2_PACKAGE_TCPDUMP=y
# BR2_PACKAGE_TCPDUMP_SMB is not set
BR2_PACKAGE_TRANSMISSION=y
BR2_PACKAGE_TRANSMISSION_UTP=y
BR2_PACKAGE_TRANSMISSION_CLI=y
# BR2_PACKAGE_TRANSMISSION_DAEMON is not set
# BR2_PACKAGE_TRANSMISSION_REMOTE is not set
BR2_PACKAGE_UDHCPD=y
BR2_PACKAGE_VLAN=y
BR2_PACKAGE_WAKELAN=y
BR2_PACKAGE_WGET=y
BR2_PACKAGE_ZEBRA=y
BR2_PACKAGE_ZEBRA_NETLINK=y
BR2_PACKAGE_ZEBRA_TCP_ZEBRA=y
# BR2_PACKAGE_ZEBRA_IPV6 is not set
# BR2_PACKAGE_ZEBRA_BGPD is not set
# BR2_PACKAGE_ZEBRA_OSPFD is not set
# BR2_PACKAGE_ZEBRA_OSPF6D is not set
# BR2_PACKAGE_ZEBRA_RIPNGD is not set
BR2_PACKAGE_ZEROCONF=y

#
# Other GUIs
#
BR2_PACKAGE_WXWIDGETS=y

#
# Router Core
#
BR2_PACKAGE_ROUTER=y
BR2_PACKAGE_ROUTER_CONFIG="$(BR2_EXTERNAL_NETGEAR_PATH)/board/r6400/router.config"
BR2_PACKAGE_ROUTER_VENDOR="netgear"
```
