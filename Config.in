## configs/r7000_defconfig
```kconfig
#
# Build options
#

#
# Commands
#
BR2_DEFCONFIG="$(BR2_EXTERNAL_NETGEAR_PATH)/configs/r7000_defconfig"
BR2_ENVIRON_CONFIGS="$(BR2_EXTERNAL_NETGEAR_PATH)/board/common/build.config $(BR2_EXTERNAL_NETGEAR_PATH)/board/common/merlin.config"
BR2_GLOBAL_EXPORT_VAR="PROFILE=R7000 VENDOR=merlin BRAND=NETGEAR"

#
# Filesystem images
#
BR2_TARGET_ROOTFS_SQUASHFS_ARGS="-regex -ef $(BR2_EXTERNAL_NETGEAR_PATH)/skeleton/merlin-exclude.txt"

#
# System configuration
#
# BR2_ROOTFS_SKELETON_DEFAULT is not set
BR2_ROOTFS_SKELETON_CUSTOM=y
BR2_ROOTFS_SKELETON_CUSTOM_PATH="$(BR2_EXTERNAL_NETGEAR_PATH)/skeleton/merlin"

#
# Kernel
#
BR2_LINUX_KERNEL_CUSTOM_CONFIG_FILE="$(BR2_EXTERNAL_NETGEAR_PATH)/board/r7000/kernel.merlin.config"
BR2_LINUX_DEPENDENCIES="src-base"
BR2_LINUX_MAKE_OPTS="SRC_BASE_DIR=$(SRC_BASE_DIR)"

#
# External options
#

#
# Netgear router external tree
#
BR2_EXTERNAL_NETGEAR_PATH="$(BR2_EXTERNAL)"

#
# Target packages
#
BR2_PACKAGE_BUSYBOX=y
BR2_PACKAGE_BUSYBOX_CONFIG="$(BR2_EXTERNAL_NETGEAR_PATH)/board/common/busybox.merlin.config"
BR2_PACKAGE_BUSYBOX_CONFIG_FRAGMENT_FILES=""
BR2_PACKAGE_BUSYBOX_SHOW_OTHERS=y
# BR2_PACKAGE_BUSYBOX_INDIVIDUAL_BINARIES is not set
# BR2_PACKAGE_BUSYBOX_WATCHDOG is not set

#
# Audio/Sound
#
# BR2_PACKAGE_ALSA_LIB is not set
BR2_PACKAGE_LIBID3TAG=y
BR2_PACKAGE_LIBVORBIS=y

#
# Audio and video applications
#
BR2_PACKAGE_FFMPEG_ARCH_SUPPORTS=y
BR2_PACKAGE_FFMPEG=y
# BR2_PACKAGE_FFMPEG_GPL is not set
# BR2_PACKAGE_FFMPEG_NONFREE is not set
BR2_PACKAGE_FFMPEG_FFMPEG=y
# BR2_PACKAGE_FFMPEG_FFPLAY is not set
# BR2_PACKAGE_FFMPEG_FFSERVER is not set
# BR2_PACKAGE_FFMPEG_FFPROBE is not set
# BR2_PACKAGE_FFMPEG_AVRESAMPLE is not set
BR2_PACKAGE_FFMPEG_SWSCALE=y
BR2_PACKAGE_FFMPEG_ENCODERS="all"
BR2_PACKAGE_FFMPEG_DECODERS="all"
BR2_PACKAGE_FFMPEG_MUXERS="all"
BR2_PACKAGE_FFMPEG_DEMUXERS="all"
BR2_PACKAGE_FFMPEG_PARSERS="all"
BR2_PACKAGE_FFMPEG_BSFS="all"
BR2_PACKAGE_FFMPEG_PROTOCOLS="all"
BR2_PACKAGE_FFMPEG_FILTERS="all"
BR2_PACKAGE_FFMPEG_INDEVS=y
BR2_PACKAGE_FFMPEG_OUTDEVS=y
BR2_PACKAGE_FFMPEG_EXTRACONF=""
BR2_PACKAGE_FLAC=y
BR2_PACKAGE_UDPXY=y

#
# Compressors and decompressors
#
# BR2_PACKAGE_BZIP2 is not set
# BR2_PACKAGE_UNZIP is not set
BR2_PACKAGE_XZ=y
# BR2_PACKAGE_XZ_XZ is not set
# BR2_PACKAGE_XZ_XZDEC is not set
# BR2_PACKAGE_XZ_LZXZDEC is not set
# BR2_PACKAGE_XZ_LZMAINFO is not set
# BR2_PACKAGE_XZ_LZMALINK is not set
# BR2_PACKAGE_XZ_LZMA_SCRIPTS is not set
# BR2_PACKAGE_ZIP is not set

#
# Development tools
#
# BR2_PACKAGE_FLEX is not set
BR2_PACKAGE_GETTEXT=y

#
# Filesystem and flash utilities
#
# BR2_PACKAGE_CRAMFS is not set
BR2_PACKAGE_E2FSPROGS=y
# BR2_PACKAGE_E2FSPROGS_DEBUGFS is not set
# BR2_PACKAGE_E2FSPROGS_E2IMAGE is not set

#
# e4defrag needs a glibc or musl toolchain
#
BR2_PACKAGE_E2FSPROGS_FSCK=y
# BR2_PACKAGE_E2FSPROGS_FUSE2FS is not set
# BR2_PACKAGE_E2FSPROGS_RESIZE2FS is not set
BR2_PACKAGE_NFS_UTILS=y
# BR2_PACKAGE_NFS_UTILS_RPCDEBUG is not set
# BR2_PACKAGE_NFS_UTILS_RPC_LOCKD is not set
# BR2_PACKAGE_NFS_UTILS_RPC_RQUOTAD is not set
BR2_PACKAGE_SQUASHFS=y
# BR2_PACKAGE_SQUASHFS_GZIP is not set
# BR2_PACKAGE_SQUASHFS_LZ4 is not set
BR2_PACKAGE_SQUASHFS_LZMA=y
# BR2_PACKAGE_SQUASHFS_LZO is not set
# BR2_PACKAGE_SQUASHFS_XZ is not set

#
# Hardware handling
#
# BR2_PACKAGE_HDPARM is not set
BR2_PACKAGE_HUB_CTRL=y
BR2_PACKAGE_SDPARM=y
# BR2_PACKAGE_USB_MODESWITCH is not set

#
# Compression and decompression
#
# BR2_PACKAGE_LZ4 is not set
BR2_PACKAGE_LZO=y
BR2_PACKAGE_ZLIB=y

#
# Crypto
#
BR2_PACKAGE_LIBGCRYPT=y
BR2_PACKAGE_LIBGPG_ERROR_ARCH_SUPPORTS=y
BR2_PACKAGE_LIBGPG_ERROR=y
BR2_PACKAGE_LIBGPG_ERROR_SYSCFG="arm-unknown-linux-gnueabi"
BR2_PACKAGE_OPENSSL=y
BR2_PACKAGE_OPENSSL_BIN=y
# BR2_PACKAGE_OPENSSL_ENGINES is not set

#
# Database
#
BR2_PACKAGE_BERKELEYDB=y
# BR2_PACKAGE_BERKELEYDB_COMPAT185 is not set
# BR2_PACKAGE_BERKELEYDB_TOOLS is not set
BR2_PACKAGE_GDBM=y
BR2_PACKAGE_SQLITE=y
# BR2_PACKAGE_SQLITE_STAT3 is not set
# BR2_PACKAGE_SQLITE_ENABLE_FTS3 is not set
# BR2_PACKAGE_SQLITE_ENABLE_JSON1 is not set
BR2_PACKAGE_SQLITE_ENABLE_UNLOCK_NOTIFY=y
# BR2_PACKAGE_SQLITE_SECURE_DELETE is not set
# BR2_PACKAGE_SQLITE_NO_SYNC is not set

#
# Graphics
#
BR2_PACKAGE_JPEG=y
BR2_PACKAGE_LIBJPEG=y
# BR2_PACKAGE_JPEG_TURBO is not set
BR2_PACKAGE_HAS_JPEG=y
BR2_PACKAGE_PROVIDES_JPEG="libjpeg"
BR2_PACKAGE_LIBEXIF=y

#
# Hardware Handling
#
# BR2_PACKAGE_DBUS is not set
BR2_PACKAGE_HOTPLUG2=y
BR2_PACKAGE_UDEV=y
BR2_PACKAGE_LIBUSB=y
BR2_PACKAGE_LIBUSB_COMPAT=y

#
# JSON/XML
#
BR2_PACKAGE_EXPAT=y
BR2_PACKAGE_JSON_C=y
BR2_PACKAGE_LIBXML2=y

#
# Multimedia
#
BR2_PACKAGE_LIBOGG=y

#
# Networking
#
BR2_PACKAGE_ACCEL_PPTP=y
# BR2_PACKAGE_COMGT is not set
BR2_PACKAGE_FORKED_DAAPD=y
# BR2_PACKAGE_GEOIP is not set
BR2_PACKAGE_LIBCURL=y
BR2_PACKAGE_CURL=y
# BR2_PACKAGE_LIBCURL_VERBOSE is not set
BR2_PACKAGE_LIBMNL=y
BR2_PACKAGE_LIBNFNETLINK=y
BR2_PACKAGE_LIBPCAP=y
BR2_PACKAGE_L7PROTOCOLS=y
BR2_TARGET_L7PROTOCOLS_PATH="rom/etc/l7-protocols"
BR2_PACKAGE_MINIUPNP=y
BR2_TARGET_ENABLE_MINIUPNPD=y
BR2_TARGET_ENABLE_MINIUPNPC=y
BR2_PACKAGE_NEON=y
# BR2_PACKAGE_NEON_ZLIB is not set
BR2_PACKAGE_NEON_SSL=y
BR2_PACKAGE_NEON_LIBXML2=y

#
# Other
#
BR2_PACKAGE_LIBDAEMON=y
# BR2_PACKAGE_LIBEV is not set
BR2_PACKAGE_LIBEVENT=y
BR2_PACKAGE_OPENPAM=y
BR2_PACKAGE_PORTMAP=y
# BR2_PACKAGE_LIBUBOX is not set
BR2_PACKAGE_UQMI=y

#
# Text and terminal handling
#
BR2_PACKAGE_LIBICONV=y
BR2_PACKAGE_NCURSES=y
# BR2_PACKAGE_NCURSES_WCHAR is not set
# BR2_PACKAGE_NCURSES_TARGET_PROGS is not set
BR2_PACKAGE_PCRE=y
# BR2_PACKAGE_PCRE_16 is not set
# BR2_PACKAGE_PCRE_32 is not set
# BR2_PACKAGE_PCRE_UTF is not set
# BR2_PACKAGE_PCRE_UCP is not set

#
# Networking applications
#
BR2_PACKAGE_6RELAYD=y
BR2_PACKAGE_AVAHI=y
# BR2_PACKAGE_AVAHI_AUTOIPD is not set
BR2_PACKAGE_AVAHI_DAEMON=y
# BR2_PACKAGE_BFTPD is not set
BR2_PACKAGE_BRIDGE_UTILS=y
# BR2_PACKAGE_DHCP is not set
BR2_PACKAGE_DNSMASQ=y
BR2_PACKAGE_DNSMASQ_TFTP=y
BR2_PACKAGE_DNSMASQ_DHCP=y
# BR2_PACKAGE_DNSMASQ_DNSSEC is not set
# BR2_PACKAGE_DNSMASQ_IDN is not set
# BR2_PACKAGE_DNSMASQ_CONNTRACK is not set
BR2_PACKAGE_DROPBEAR=y
BR2_PACKAGE_DROPBEAR_CLIENT=y
# BR2_PACKAGE_DROPBEAR_DISABLE_REVERSEDNS is not set
BR2_PACKAGE_DROPBEAR_SMALL=y
# BR2_PACKAGE_DROPBEAR_WTMP is not set
# BR2_PACKAGE_DROPBEAR_LASTLOG is not set
BR2_PACKAGE_EBTABLES=y

#
# ebtables needs a glibc or uClibc toolchain
#
BR2_PACKAGE_EMAIL=y
BR2_PACKAGE_EZ_IPUPDATE=y
BR2_PACKAGE_IGMPPROXY=y
# BR2_PACKAGE_IGMPV3PROXY is not set
BR2_PACKAGE_IPROUTE2=y
BR2_PACKAGE_IPSET=y
BR2_PACKAGE_IPTABLES=y
# BR2_PACKAGE_IPTABLES_BPF_NFSYNPROXY is not set
BR2_PACKAGE_IPTABLES_IPV4=y
BR2_PACKAGE_IPTABLES_IPV6=y
BR2_PACKAGE_IPTABLES_EXTENSIONS=y

#
# nftables compat needs a toolchain w/ wchar, dynamic library, headers >= 3.12
#
# BR2_PACKAGE_L2TPD is not set
BR2_PACKAGE_LIGHTTPD=y
BR2_PACKAGE_LIGHTTPD_OPENSSL=y
# BR2_PACKAGE_LIGHTTPD_ZLIB is not set
# BR2_PACKAGE_LIGHTTPD_BZIP2 is not set
BR2_PACKAGE_LIGHTTPD_PCRE=y
BR2_PACKAGE_LIGHTTPD_WEBDAV=y
BR2_PACKAGE_LIGHTTPD_SAMBA=y
BR2_PACKAGE_LPRNG=y
BR2_PACKAGE_MINIDLNA=y
BR2_PACKAGE_NETATALK=y
BR2_PACKAGE_NETATALK_ATFUNCS=y
BR2_PACKAGE_NETSNMP=y
BR2_PACKAGE_NETSNMP_SERVER=y
# BR2_PACKAGE_NETSNMP_CLIENTS is not set
BR2_PACKAGE_NETSNMP_ENABLE_MIBS=y
BR2_PACKAGE_NETSNMP_WITH_MIB_MODULES="host/hr_device,host/hr_disk,host/hr_filesys,host/hr_network,host/hr_partition,host/hr_proc,host/hr_storage,host/hr_system,if-mib/ifXTable,mibII/at,mibII/icmp,mibII/ifTable,mibII/ip,mibII/snmp_mib,mibII/sysORTable,mibII/system_mib,mibII/tcp,mibII/udp,mibII/vacm_context,mibII/vacm_vars,tunnel,ucd-snmp/disk,ucd-snmp/dlmod,ucd-snmp/extensible,ucd-snmp/loadave,ucd-snmp/memory,ucd-snmp/pass,ucd-snmp/proc,ucd-snmp/vmstat,util_funcs"
BR2_PACKAGE_NETSTAT_NAT=y
BR2_PACKAGE_NTPCLIENT=y
BR2_PACKAGE_ODHCP6C=y
BR2_PACKAGE_OPENVPN=y
# BR2_PACKAGE_OPENVPN_LZ4 is not set
BR2_PACKAGE_OPENVPN_LZO=y
BR2_PACKAGE_OPENVPN_SMALL=y
BR2_PACKAGE_PHDDNS=y
BR2_PACKAGE_PPPD=y
# BR2_PACKAGE_PPPD_FILTER is not set
# BR2_PACKAGE_PPPD_RADIUS is not set
# BR2_PACKAGE_PPPOECD is not set
# BR2_PACKAGE_PPTP is not set
BR2_PACKAGE_QUAGGA=y
BR2_PACKAGE_QUAGGA_ZEBRA=y
BR2_PACKAGE_QUAGGA_BGPD=y
BR2_PACKAGE_QUAGGA_WATCHQUAGGA=y
# BR2_PACKAGE_RADVD is not set
BR2_PACKAGE_RP_PPPOE=y
BR2_PACKAGE_RP_L2TP=y
BR2_PACKAGE_SAMBA=y
BR2_PACKAGE_SAMBA_MAX_DEBUGLEVEL=-1
# BR2_PACKAGE_SAMBA_LIBICONV is not set

#
# Samba tools selection
#
# BR2_PACKAGE_SAMBA_EVENTLOGADM is not set

#
# findsmb       - disabled (requires nmblookup, smbclient and perl)
#
# BR2_PACKAGE_SAMBA_NET is not set
BR2_PACKAGE_SAMBA_NMBD=y
# BR2_PACKAGE_SAMBA_NMBLOOKUP is not set
# BR2_PACKAGE_SAMBA_NTLM_AUTH is not set
# BR2_PACKAGE_SAMBA_PDBEDIT is not set
# BR2_PACKAGE_SAMBA_PROFILES is not set
# BR2_PACKAGE_SAMBA_RPCCLIENT is not set
# BR2_PACKAGE_SAMBA_SMBCACLS is not set
# BR2_PACKAGE_SAMBA_SMBCLIENT is not set
# BR2_PACKAGE_SAMBA_SMBCONTROL is not set
# BR2_PACKAGE_SAMBA_SMBCQUOTAS is not set
BR2_PACKAGE_SAMBA_SMBD=y
# BR2_PACKAGE_SAMBA_SMBGET is not set
# BR2_PACKAGE_SAMBA_SMBLDBTOOLS is not set
# BR2_PACKAGE_SAMBA_SMBPASSWD is not set
# BR2_PACKAGE_SAMBA_SMBSHARESEC is not set
# BR2_PACKAGE_SAMBA_SMBSPOOL is not set
# BR2_PACKAGE_SAMBA_SMBSTATUS is not set
# BR2_PACKAGE_SAMBA_SMBTREE is not set
# BR2_PACKAGE_SAMBA_SWAT is not set
# BR2_PACKAGE_SAMBA_SMBTA_UTIL is not set

#
# smbtar        - disabled (requires smbclient)
#
# BR2_PACKAGE_SAMBA_TDB is not set
# BR2_PACKAGE_SAMBA_TESTPARM is not set
# BR2_PACKAGE_SAMBA_WINBINDD is not set
# BR2_PACKAGE_SAMBA_CIFS_MOUNT is not set

#
# Samba libraries selection
#
BR2_PACKAGE_SAMBA_LIBSMBCLIENT=y

#
# Samba support selection
#

#
# support avahi - disabled (requires avahi-daemon)
#

#
# support gamin - disabled (requires gamin)
#
# BR2_PACKAGE_TCPDUMP is not set
BR2_PACKAGE_TOR=y
# BR2_PACKAGE_UDHCPD is not set
# BR2_PACKAGE_VLAN is not set
BR2_PACKAGE_VSFTPD=y
# BR2_PACKAGE_VSFTPD_UTMPX is not set
# BR2_PACKAGE_WAKELAN is not set
BR2_PACKAGE_WGET=y
# BR2_PACKAGE_WPA_SUPPLICANT is not set
# BR2_PACKAGE_ZEROCONF is not set

#
# Shell and utilities
#

#
# Utilities
#
BR2_PACKAGE_EASY_RSA=y

#
# Text editors and viewers
#
# BR2_PACKAGE_NANO is not set

#
# Router Core
#
BR2_PACKAGE_ROUTER=y
BR2_PACKAGE_ROUTER_CONFIG="$(BR2_EXTERNAL_NETGEAR_PATH)/board/r7000/router.merlin.config"
BR2_PACKAGE_ROUTER_VENDOR="merlin"
BR2_PACKAGE_SRC_BASE_OVERRIDED_TARGET="$(BR2_EXTERNAL_NETGEAR_PATH)/board/r7000/target.merlin.alt.mak"
```

## package/6relayd/Config.in
```kconfig
config BR2_PACKAGE_6RELAYD
	bool "6relayd - Embedded DHCPv6/RA Server & Relay"
	help
	  6relayd is a daemon for serving and relaying IPv6 management
	  protocols to configure clients and downstream routers. It tries
	  to follow the RFC6204 requirements for IPv6 home routers.

	  6relayd provides server services for RA, stateless and stateful
	  DHCPv6, prefix delegation and can be used to relay RA, DHCPv6
	  and NDP between routed (non-bridged) interfaces in case no
	  delegated prefixes are available.
```

## package/accel-pptp/Config.in
```kconfig
config BR2_PACKAGE_ACCEL_PPTP
	bool "accel-pptp"
	help
	  The ACCEL-PPTP is PPTP client/server based on POPTOP (http://www.poptop.org)
	  and PPTPCLIENT (http://pptpclient.sourceforge.net).

	  ACCEL-PPTP uses kernel module to increase performance and decrease system
	  usage. For more documentation about PPTP visit POPTOP web site. ACCEL-PPTP
	  was successfully tested on about 1200 connections and system usage has been
	  decreased by ~50% on comparisons with the original poptop server.

	  http://accel-pptp.sourceforge.net
```

## package/amule/Config.in
```kconfig
config BR2_PACKAGE_AMULE
	bool "aMule"
	help
	  aMule is an eMule-like client for the eD2k and Kademlia networks,
	  supporting multiple platforms.

	  http://amule.org/
```

## package/bftpd/Config.in
```kconfig
config BR2_PACKAGE_BFTPD
	bool "bftpd"
	help
	  bftpd is an FTP server for Linux, BSD/OS, FreeBSD, Solaris, DG-UX and
	  True64. It runs either with inetd or standalone.
	  
	  It tries to be very configurable while being fast and small. You can
	  make defaults for each configuration option, and then override these
	  defaults in user-specific and directory-specific structures.
```

## package/comgt/Config.in
```kconfig
config BR2_PACKAGE_COMGT
	bool "comgt"
	help
	  comgt is a command line tool for controlling, configuring
	  and interacting with Option Wireless 3G and 2G (HSDPA, UMTS,
	  EDGE, GPRS, GSM) data devices within the Linux environment.
```

## package/dhcp/Config.in
```kconfig
config BR2_PACKAGE_DHCP
	bool "dhcp (ISC)"
	# fork()
	depends on BR2_USE_MMU
	depends on BR2_PACKAGE_BUSYBOX_SHOW_OTHERS
	help
	  DHCP relay agent from the ISC DHCP distribution.

	  http://www.isc.org/products/DHCP
```

## package/email/Config.in
```kconfig
config BR2_PACKAGE_EMAIL
	bool "email"
	help
	  Programs to send email via the command line to remote SMTP server.
```

## package/ez-ipupdate/Config.in
```kconfig
config BR2_PACKAGE_EZ_IPUPDATE
	bool "ez-ipupdate"
	help
	  Ez-ipupdate is a client for the dynamic IP service.
      
	  http://www.ez-ip.net.
```

## package/forked-daapd/Config.in
```kconfig
config BR2_PACKAGE_FORKED_DAAPD
	bool "forked-daapd"
	help
	  forked-daapd is a DAAP and RSP media server, whith support
	  for Linux and FreeBSD. It is a complete rewrite of mt-daapd
	  (Firefly Media Server).

	  DAAP stands for Digital Audio Access Protocol, and is the
	  protocol used by iTunes and friends to share/stream media
	  libraries over network.

	  RSP is Roku's own media sharing protocol. Roku are the marks
	  of the SoundBridge devices. See <http://www.roku.com>.
```

## package/hd-idle/Config.in
```kconfig
config BR2_PACKAGE_HD_IDLE
	bool "Hard disk idle spin-down utility"
	help
	  hd-idle is a utility program for spinning-down external disks after a
	  period of idle time. Sine most external IDE disk enclosures don't support
	  setting the IDE idle timer, a program like hd-idle is required to spin
	  down idle disks automatically.

	  http://hd-idle.sf.net
```

## package/hotplug2/Config.in
```kconfig
config BR2_PACKAGE_HOTPLUG2
	bool "hotplug2"
	help
	  hotplug2 is aimed at early Linux user space, that is, initramfs or
	  initrd, possibly also at embedded devices (such as WRT-lik router) or
	  very weak machines, such as 386/486.

	  hotplug2 connects to the uevent netlink socket and read events. The
	  application generally operates in two modes, dumb and smart. And hotplug2
	  supports cold plugging simply by calling the 'udevtrigger' binary
	  internally. As udevtrigger is fairly independent on the reset of udev,
	  it can be easily embedded along with hotplug2.

	  http://marc.theaimsgroup.com/?l=linux-hotplug-devel&m=115720744227751&w=2
```

## package/hub-ctrl/Config.in
```kconfig
config BR2_PACKAGE_HUB_CTRL
	bool "hub-ctrl"
	help
	  program to control port power/led of USB hub
```

## package/igmpv3proxy/Config.in
```kconfig
config BR2_PACKAGE_IGMPV3PROXY
	bool "igmpv3proxy"
	depends on BR2_USE_MMU # fork()
	depends on BR2_USE_WCHAR
	help
	  A simple dynamic Multicast Routing Daemon
	  using only IGMP signalling. It's intended
	  for simple forwarding of Multicast traffic
	  between networks.

	  http://madynes.loria.fr/igmpv3proxy/

comment "igmpproxy needs a toolchain w/ wchar"
	depends on BR2_USE_MMU
	depends on !BR2_USE_WCHAR
```

## package/l2tpd/Config.in
```kconfig
config BR2_PACKAGE_L2TPD
	bool "l2tpd"
	help
	  l2tpd is an implementation of the layer two tunneling protocol. It works
	  in user space completely (althought kernel work is planned after the
	  userspace version is stablized). l2tpd works by opening a pseudo-tty for
	  communcating with pppd. Although 2tpd was written for Linux, the current
	  version should be highly portable to other UNIX's supported by pppd.
```
