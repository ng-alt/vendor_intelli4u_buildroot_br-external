## Config.in
```kconfig
menu "Target packages"
	source "package/busybox/Config.in"

menu "Audio/Sound"
	source "package/alsa-lib/Config.in"
	source "package/libid3tag/Config.in"
	source "package/libvorbis/Config.in"
endmenu

menu "Audio and video applications"
	source "package/ffmpeg/Config.in"
	source "package/flac/Config.in"
endmenu

menu "Compressors and decompressors"
	source "package/bzip2/Config.in"
	source "package/unzip/Config.in"
	source "package/xz/Config.in"
	source "package/zip/Config.in"
endmenu

menu "Development tools"
	source "package/flex/Config.in"
	source "package/gettext/Config.in"
	source "package/gperf/Config.in"
	source "package/libavl/Config.in"
endmenu

menu "Filesystem and flash utilities"
	source "package/cramfs/Config.in"
	source "package/mtools/Config.in"
	source "package/ntfs-3g/Config.in"
	source "package/squashfs/Config.in"
endmenu

menu "Compression and decompression"
	source "package/lz4/Config.in"
	source "package/lzo/Config.in"
	source "package/zlib/Config.in"
endmenu

menu "Crypto"
	source "package/libcryptoxx/Config.in"
	source "package/libgcrypt/Config.in"
	source "package/libgpg-error/Config.in"
	source "package/openssl/Config.in"
endmenu

menu "Database"
	source "package/berkeleydb/Config.in"
	source "package/gdbm/Config.in"
	source "package/sqlite/Config.in"
endmenu

menu "Filesystem"
	source "package/libconfuse/Config.in"
endmenu

menu "Graphics"
	source "package/jpeg/Config.in"
	source "package/libexif/Config.in"
endmenu

menu "Hardware Handling"
	source "package/dbus/Config.in"
	source "package/hd-idle/Config.in"
	source "package/hdparm/Config.in"
	source "package/hotplug2/Config.in"
	source "package/udev/Config.in"
endmenu

menu "Interpreter languages and scripting"
	source "package/python/Config.in"
endmenu

menu "JSON/XML"
	source "package/expat/Config.in"
	source "package/libxml2/Config.in"
	source "package/mxml/Config.in"
endmenu

menu "Multimedia"
	source "package/libogg/Config.in"
endmenu

menu "Networking"
	source "package/geoip/Config.in"
	source "package/libcurl/Config.in"
	source "package/libpcap/Config.in"
endmenu

menu "Other"
	source "package/libantlr/Config.in"
	source "package/libdaemon/Config.in"
	source "package/libevent/Config.in"
endmenu

menu "Text and terminal handling"
	source "package/libiconv/Config.in"
	source "package/libunistring/Config.in"
endmenu

menu "Networking applications"
	source "package/amule/Config.in"
	source "package/avahi/Config.in"
	source "package/bftpd/Config.in"
	source "package/bridge-utils/Config.in"
	source "package/dhcp/Config.in"
	source "package/dnsmasq/Config.in"
	source "package/forked-daapd/Config.in"
	source "package/igmpv3proxy/Config.in"
	source "package/iperf/Config.in"
	source "package/iproute2/Config.in"
	source "package/iptables/Config.in"
	source "package/l2tpd/Config.in"
	source "package/minidlna/Config.in"
	source "package/netatalk/Config.in"
	source "package/ntpclient/Config.in"
	source "package/openvpn/Config.in"
	source "package/pppd/Config.in"
	source "package/pppoecd/Config.in"
	source "package/pptp/Config.in"
	source "package/radvd/Config.in"
	source "package/samba4/Config.in"
	source "package/tcpdump/Config.in"
	source "package/transmission/Config.in"
	source "package/udhcpd/Config.in"
	source "package/vlan/Config.in"
	source "package/wakelan/Config.in"
	source "package/wget/Config.in"
	source "package/zebra/Config.in"
	source "package/zeroconf/Config.in"
endmenu

menu "Other GUIs"
	source "package/wxwidgets/Config.in"
endmenu

menu "Router Core"
	source "package/router/Config.in"
endmenu

endmenu
```

## Config.in.host
```kconfig
menu "Host utilities"

	source "package/cramfs/Config.in.host"
	source "package/zip/Config.in.host"

endmenu
```

## configs/r6300v2_defconfig
```kconfig
#
# Build options
#

#
# Commands
#
BR2_DEFCONFIG="$(BR2_EXTERNAL_NETGEAR_PATH)/configs/r6300v2_defconfig"
BR2_ENVIRON_CONFIGS="$(BR2_EXTERNAL_NETGEAR_PATH)/board/common/build.config $(BR2_EXTERNAL_NETGEAR_PATH)/board/common/netgear.config"
BR2_GLOBAL_EXPORT_VAR="PROFILE=R6300v2 VENDOR=netgear"

#
# Kernel
#
BR2_LINUX_KERNEL_CUSTOM_CONFIG_FILE="$(BR2_EXTERNAL_NETGEAR_PATH)/board/r6300v2/kernel.config"

#
# External options
#

#
# Netgear router external tree
#
BR2_EXTERNAL_NETGEAR_PATH="$(BR2_EXTERNAL)"

#
# Target packages
#
BR2_PACKAGE_BUSYBOX=y
BR2_PACKAGE_BUSYBOX_CONFIG="$(BR2_EXTERNAL_NETGEAR_PATH)/board/common/busybox.config"
BR2_PACKAGE_BUSYBOX_CONFIG_FRAGMENT_FILES=""
BR2_PACKAGE_BUSYBOX_SHOW_OTHERS=y
# BR2_PACKAGE_BUSYBOX_INDIVIDUAL_BINARIES is not set
# BR2_PACKAGE_BUSYBOX_WATCHDOG is not set

#
# Audio/Sound
#
BR2_PACKAGE_LIBID3TAG=y
BR2_PACKAGE_LIBVORBIS=y

#
# Audio and video applications
#
BR2_PACKAGE_FFMPEG_ARCH_SUPPORTS=y
BR2_PACKAGE_FFMPEG=y
# BR2_PACKAGE_FFMPEG_GPL is not set
# BR2_PACKAGE_FFMPEG_NONFREE is not set
BR2_PACKAGE_FFMPEG_FFMPEG=y
# BR2_PACKAGE_FFMPEG_FFPLAY is not set
# BR2_PACKAGE_FFMPEG_FFSERVER is not set
# BR2_PACKAGE_FFMPEG_FFPROBE is not set
# BR2_PACKAGE_FFMPEG_AVRESAMPLE is not set
BR2_PACKAGE_FFMPEG_SWSCALE=y
BR2_PACKAGE_FFMPEG_ENCODERS="all"
BR2_PACKAGE_FFMPEG_DECODERS="all"
BR2_PACKAGE_FFMPEG_MUXERS="all"
BR2_PACKAGE_FFMPEG_DEMUXERS="all"
BR2_PACKAGE_FFMPEG_PARSERS="all"
BR2_PACKAGE_FFMPEG_BSFS="all"
BR2_PACKAGE_FFMPEG_PROTOCOLS="all"
BR2_PACKAGE_FFMPEG_FILTERS="all"
BR2_PACKAGE_FFMPEG_INDEVS=y
BR2_PACKAGE_FFMPEG_OUTDEVS=y
BR2_PACKAGE_FFMPEG_EXTRACONF=""
BR2_PACKAGE_FLAC=y

#
# Compressors and decompressors
#
BR2_PACKAGE_BZIP2=y
BR2_PACKAGE_UNZIP=y
BR2_PACKAGE_XZ=y
# BR2_PACKAGE_XZ_XZ is not set
# BR2_PACKAGE_XZ_XZDEC is not set
# BR2_PACKAGE_XZ_LZXZDEC is not set
# BR2_PACKAGE_XZ_LZMAINFO is not set
# BR2_PACKAGE_XZ_LZMALINK is not set
# BR2_PACKAGE_XZ_LZMA_SCRIPTS is not set
BR2_PACKAGE_ZIP=y

#
# Development tools
#
BR2_PACKAGE_FLEX=y
BR2_PACKAGE_GETTEXT=y

#
# Filesystem and flash utilities
#
# BR2_PACKAGE_CRAMFS is not set
BR2_PACKAGE_SQUASHFS=y
# BR2_PACKAGE_SQUASHFS_GZIP is not set
# BR2_PACKAGE_SQUASHFS_LZ4 is not set
BR2_PACKAGE_SQUASHFS_LZMA=y
# BR2_PACKAGE_SQUASHFS_LZO is not set
# BR2_PACKAGE_SQUASHFS_XZ is not set

#
# Compression and decompression
#
# BR2_PACKAGE_LZ4 is not set
BR2_PACKAGE_LZO=y
BR2_PACKAGE_ZLIB=y

#
# Crypto
#
BR2_PACKAGE_OPENSSL=y
BR2_PACKAGE_OPENSSL_BIN=y
# BR2_PACKAGE_OPENSSL_ENGINES is not set

#
# Database
#
BR2_PACKAGE_SQLITE=y
# BR2_PACKAGE_SQLITE_STAT3 is not set
# BR2_PACKAGE_SQLITE_ENABLE_FTS3 is not set
# BR2_PACKAGE_SQLITE_ENABLE_JSON1 is not set
BR2_PACKAGE_SQLITE_ENABLE_UNLOCK_NOTIFY=y
# BR2_PACKAGE_SQLITE_SECURE_DELETE is not set
# BR2_PACKAGE_SQLITE_NO_SYNC is not set

#
# Graphics
#
BR2_PACKAGE_JPEG=y
BR2_PACKAGE_LIBJPEG=y
# BR2_PACKAGE_JPEG_TURBO is not set
BR2_PACKAGE_HAS_JPEG=y
BR2_PACKAGE_PROVIDES_JPEG="libjpeg"
BR2_PACKAGE_LIBEXIF=y

#
# Hardware Handling
#
BR2_PACKAGE_HOTPLUG2=y
BR2_PACKAGE_UDEV=y

#
# Interpreter languages and scripting
#
BR2_PACKAGE_PYTHON=y
# BR2_PACKAGE_PYTHON_PY_ONLY is not set
# BR2_PACKAGE_PYTHON_PYC_ONLY is not set
# BR2_PACKAGE_PYTHON_PY_PYC is not set

#
# JSON/XML
#
# BR2_PACKAGE_LIBXML2 is not set

#
# Multimedia
#
BR2_PACKAGE_LIBOGG=y

#
# Networking
#
# BR2_PACKAGE_GEOIP is not set
# BR2_PACKAGE_LIBCURL is not set
# BR2_PACKAGE_LIBPCAP is not set

#
# Networking applications
#
BR2_PACKAGE_BFTPD=y
BR2_PACKAGE_BRIDGE_UTILS=y
BR2_PACKAGE_DHCP=y
BR2_PACKAGE_DNSMASQ=y
BR2_PACKAGE_DNSMASQ_TFTP=y
BR2_PACKAGE_DNSMASQ_DHCP=y
# BR2_PACKAGE_DNSMASQ_DNSSEC is not set
# BR2_PACKAGE_DNSMASQ_IDN is not set
# BR2_PACKAGE_DNSMASQ_CONNTRACK is not set
BR2_PACKAGE_IGMPV3PROXY=y
BR2_PACKAGE_IPROUTE2=y
BR2_PACKAGE_IPTABLES=y
# BR2_PACKAGE_IPTABLES_BPF_NFSYNPROXY is not set
BR2_PACKAGE_IPTABLES_IPV4=y
BR2_PACKAGE_IPTABLES_IPV6=y
# BR2_PACKAGE_IPTABLES_EXTENSIONS is not set

#
# nftables compat needs a toolchain w/ wchar, dynamic library, headers >= 3.12
#
BR2_PACKAGE_L2TPD=y
BR2_PACKAGE_MINIDLNA=y
BR2_PACKAGE_NTPCLIENT=y
BR2_PACKAGE_OPENVPN=y
# BR2_PACKAGE_OPENVPN_LZ4 is not set
BR2_PACKAGE_OPENVPN_LZO=y
# BR2_PACKAGE_OPENVPN_SMALL is not set
BR2_PACKAGE_PPPD=y
# BR2_PACKAGE_PPPD_FILTER is not set
# BR2_PACKAGE_PPPD_RADIUS is not set
BR2_PACKAGE_PPPOECD=y
BR2_PACKAGE_PPTP=y
BR2_PACKAGE_RADVD=y
BR2_PACKAGE_SAMBA4=y
# BR2_PACKAGE_SAMBA4_AD_DC is not set
# BR2_PACKAGE_SAMBA4_ADS is not set
# BR2_PACKAGE_SAMBA4_SMBTORTURE is not set
BR2_PACKAGE_TCPDUMP=y
# BR2_PACKAGE_TCPDUMP_SMB is not set
BR2_PACKAGE_UDHCPD=y
BR2_PACKAGE_VLAN=y
BR2_PACKAGE_WGET=y
BR2_PACKAGE_ZEBRA=y
BR2_PACKAGE_ZEBRA_NETLINK=y
BR2_PACKAGE_ZEBRA_TCP_ZEBRA=y
# BR2_PACKAGE_ZEBRA_IPV6 is not set
# BR2_PACKAGE_ZEBRA_BGPD is not set
# BR2_PACKAGE_ZEBRA_OSPFD is not set
# BR2_PACKAGE_ZEBRA_OSPF6D is not set
# BR2_PACKAGE_ZEBRA_RIPNGD is not set
BR2_PACKAGE_ZEROCONF=y

#
# Router Core
#
BR2_PACKAGE_ROUTER=y
BR2_PACKAGE_ROUTER_CONFIG="$(BR2_EXTERNAL_NETGEAR_PATH)/board/r6300v2/router.config"
BR2_PACKAGE_ROUTER_VENDOR="netgear"
```
